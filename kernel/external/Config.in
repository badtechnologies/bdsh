## kernel/external/Config.in
```kconfig
source "$BR2_EXTERNAL_BADOS_KERNEL_PATH/package/python-icmplib/Config.in"
source "$BR2_EXTERNAL_BADOS_KERNEL_PATH/package/bdsh/Config.in"
```

## kernel/external/configs/bados_x86_64_defconfig
```kconfig
BR2_x86_64=y
BR2_PACKAGE_HOST_LINUX_HEADERS_CUSTOM_6_12=y
BR2_GLOBAL_PATCH_DIR="board/qemu/patches"
BR2_DOWNLOAD_FORCE_CHECK_HASHES=y
BR2_TARGET_GENERIC_HOSTNAME="bados"
BR2_TARGET_GENERIC_ISSUE="Welcome to BadOS 0.7.0!"
BR2_INIT_NONE=y
BR2_SYSTEM_BIN_SH_NONE=y
# BR2_TARGET_GENERIC_GETTY is not set
BR2_ROOTFS_POST_BUILD_SCRIPT="board/qemu/x86_64/post-build.sh"
BR2_ROOTFS_POST_IMAGE_SCRIPT="board/qemu/post-image.sh"
BR2_ROOTFS_POST_SCRIPT_ARGS="$(BR2_DEFCONFIG)"
BR2_LINUX_KERNEL=y
BR2_LINUX_KERNEL_CUSTOM_VERSION=y
BR2_LINUX_KERNEL_CUSTOM_VERSION_VALUE="6.12.27"
BR2_LINUX_KERNEL_USE_CUSTOM_CONFIG=y
BR2_LINUX_KERNEL_CUSTOM_CONFIG_FILE="board/qemu/x86_64/linux.config"
BR2_LINUX_KERNEL_CONFIG_FRAGMENT_FILES="$(BR2_EXTERNAL_BADOS_KERNEL_PATH)/board/bados/kernel.config"
BR2_LINUX_KERNEL_NEEDS_HOST_LIBELF=y
BR2_LINUX_KERNEL_NEEDS_HOST_PYTHON3=y
# BR2_PACKAGE_BUSYBOX is not set
BR2_PACKAGE_PYTHON3=y
# BR2_PACKAGE_PYTHON3_UNICODEDATA is not set
BR2_PACKAGE_BDSH=y
BR2_TARGET_ROOTFS_CPIO=y
BR2_TARGET_ROOTFS_CPIO_GZIP=y
BR2_TARGET_ROOTFS_EXT2=y
BR2_TARGET_ROOTFS_EXT2_4=y
BR2_TARGET_ROOTFS_EXT2_SIZE="512M"
# BR2_TARGET_ROOTFS_TAR is not set
```

## kernel/external/package/bdsh/Config.in
```kconfig
config BR2_PACKAGE_BDSH
	bool "bdsh"
	depends on BR2_PACKAGE_PYTHON3
	select BR2_PACKAGE_PYTHON_ARGON2_CFFI
	select BR2_PACKAGE_PYTHON_ICMPLIB
	select BR2_PACKAGE_PYTHON_PSUTIL
	select BR2_PACKAGE_PYTHON_REQUESTS
	select BR2_PACKAGE_PYTHON3_ZLIB
	help
	  Bad Technologies' Python shell, installed from the project source tree.
```

## kernel/external/package/python-bdsh/Config.in
```kconfig
config BR2_PACKAGE_PYTHON_BDSH
	bool "python-bdsh"
	depends on BR2_PACKAGE_PYTHON3
	help
	  Bad Technologies' Python shell, installed from the project source tree.
```

## kernel/external/package/python-icmplib/Config.in
```kconfig
config BR2_PACKAGE_PYTHON_ICMPLIB
	bool "python-icmplib"
	depends on BR2_PACKAGE_PYTHON3
	help
	  A pure Python library for sending and receiving ICMP packets.
```
